## config/boards/shields/yoga3_mono/Kconfig.defconfig
```kconfig
if SHIELD_YOGA3_MONO

config ZMK_KEYBOARD_NAME
    default "Yoga Mono 3R"

endif
```

## config/boards/shields/yoga3_split/Kconfig.defconfig
```kconfig
if SHIELD_YOGA3_SPLIT_LEFT

config ZMK_KEYBOARD_NAME
    default "Yoga Split 3R"

config ZMK_SPLIT_ROLE_CENTRAL
    default y

endif

if SHIELD_YOGA3_SPLIT_LEFT || SHIELD_YOGA3_SPLIT_RIGHT

config ZMK_SPLIT
    default y

endif
```

## config/boards/shields/yoga3_split/Kconfig.shield
```kconfig
config SHIELD_YOGA3_SPLIT_LEFT
    def_bool $(shields_list_contains,yoga3_split_left)

config SHIELD_YOGA3_SPLIT_RIGHT
    def_bool $(shields_list_contains,yoga3_split_right)
```

## config/boards/shields/yoga_status_leds/Kconfig.shield
```kconfig
config SHIELD_YOGA_STATUS_LEDS
    def_bool $(shields_list_contains,yoga_status_leds)
```

## zmk-config/config/boards/shields/yoga_split/Kconfig.shield
```kconfig
config SHIELD_YOGA_SPLIT_LEFT
    def_bool $(shields_list_contains,yoga_split_left)

config SHIELD_YOGA_SPLIT_RIGHT
    def_bool $(shields_list_contains,yoga_split_right)
```
